## kernel/bsp/maix3/applications/Kconfig
```kconfig
menu "Applications Configuration"

    menuconfig RT_AUTO_RESIZE_PARTITION
        bool "Enable auto resize partition"
        default y
        help
            Support auto resize the last partition, use the disk remain space
            Now just support MMC device and MBR partition table.

        if RT_AUTO_RESIZE_PARTITION
            config RT_AUTO_RESIZE_PARTITION_NR
                int "Resize partition id"
                default 2

        endif

endmenu
```

## kernel/bsp/maix3/components/Kconfig
```kconfig
menu "Components Configuration"

    menuconfig ENABLE_CHERRY_USB
        bool "Enable CherryUSB"

        if ENABLE_CHERRY_USB
            config CHERRYUSB_DEVICE_DWC2_K230
                def_bool y

            config CHERRYUSB_HOST_DWC2_K230
                def_bool y

            config CHERRY_USB_OSAL_RTTHREAD
                def_bool y

            menuconfig ENABLE_CHERRY_USB_DEVICE
                bool "Enable CherryUSB Device"
                default n

                if ENABLE_CHERRY_USB_DEVICE
                    choice CHERRY_USB_DEVICE_USING_DEV
                        bool "CherryUSB Device Use Device"
                        default CHERRY_USB_DEVICE_USING_DEV0

                        config CHERRY_USB_DEVICE_USING_DEV0
                            bool "Using Dev0"

                        config CHERRY_USB_DEVICE_USING_DEV1
                            bool "Using Dev1"
                    endchoice

                    config CHERRY_USB_DEVICE_USING_DEV
                        int
                        default 0 if CHERRY_USB_DEVICE_USING_DEV0
                        default 1 if CHERRY_USB_DEVICE_USING_DEV1

                    config CHERRY_USB_DEVICE_SPEED_HS
                        def_bool y

                    config CHERRY_USB_DEVICE_ENABLE_CLASS_CDC_ACM
                        bool "Enable CDC ACM"

                    config CHERRY_USB_DEVICE_ENABLE_CLASS_MSC
                        bool "Enable MSC"

                    config CHERRY_USB_DEVICE_ENABLE_CLASS_MTP
                        bool "Enable MTP"
                        select CHERRY_USB_DEVICE_ENABLE_CLASS_MSC
                endif

            config ENABLE_CANMV_USB_DEV
                bool "Enable USB Device for CanMV"
                default y
                select CHERRY_USB_DEVICE_ENABLE_CLASS_CDC_ACM
                select CHERRY_USB_DEVICE_ENABLE_CLASS_MTP
                help
                    CanMV USB Device Select class CDC_ACM and MSC MTP

            menuconfig ENABLE_CHERRY_USB_HOST
                bool "Enable CherryUSB Host"
                default n

                if ENABLE_CHERRY_USB_HOST

                    choice CHERRY_USB_HOST_USING_DEV
                        bool "CherryUSB Host Use Device"
                        default CHERRY_USB_HOST_USING_DEV0

                        config CHERRY_USB_HOST_USING_DEV0
                            bool "Using Dev0"

                        config CHERRY_USB_HOST_USING_DEV1
                            bool "Using Dev1"
                    endchoice

                    config CHERRY_USB_HOST_USING_DEV
                        int
                        default 0 if CHERRY_USB_HOST_USING_DEV0
                        default 1 if CHERRY_USB_HOST_USING_DEV1

                    config CHERRY_USB_HOST_ENABLE_CLASS_HID
                        bool "Enable HID"
                        default n

                    config CHERRY_USB_HOST_ENABLE_CLASS_NET_RTL8152
                        bool "Enable net RTL8152"
                        default y

                endif

            config ENABLE_CANMV_USB_HOST
                bool "Enable USB Host for CanMV"
                default n
                select CHERRY_USB_HOST_ENABLE_CLASS_NET_RTL8152
                help
                    CanMV USB Host Select class net/rtl8152

            config CANMV_USB_HOST_NET_RTL8152_DEV_NAME
                string
                default "u0"
        endif

    config RT_USING_DEVMEM2
        bool "Enable devmem2"
        def_bool y

    config RT_USING_USAGE
        bool "Enable CPU usage"
        def_bool y

    config ENABLE_NETWORK_MGMT_DEV
        bool "Enable NetWork Mgmt for CanMV"
        default n

    config ENABLE_MEM_INFO_DEV
        bool "Enable meminfo Device for CanMV"
        default n

endmenu
```

## kernel/bsp/maix3/configs/k230d_canmv_atk_dnk230d_defconfig
```kconfig
CONFIG_RT_NAME_MAX=20
CONFIG_RT_USING_SMART=y
CONFIG_RT_ALIGN_SIZE=8
CONFIG_RT_THREAD_PRIORITY_32=y
CONFIG_RT_THREAD_PRIORITY_MAX=32
CONFIG_RT_TICK_PER_SECOND=1000
CONFIG_RT_USING_OVERFLOW_CHECK=y
CONFIG_RT_USING_HOOK=y
CONFIG_RT_USING_IDLE_HOOK=y
CONFIG_RT_IDLE_HOOK_LIST_SIZE=4
CONFIG_IDLE_THREAD_STACK_SIZE=16384
CONFIG_RT_USING_TIMER_SOFT=y
CONFIG_RT_TIMER_THREAD_PRIO=4
CONFIG_RT_TIMER_THREAD_STACK_SIZE=16384
CONFIG_RT_DEBUG=y
CONFIG_RT_USING_SEMAPHORE=y
CONFIG_RT_USING_MUTEX=y
CONFIG_RT_USING_EVENT=y
CONFIG_RT_USING_MAILBOX=y
CONFIG_RT_USING_MESSAGEQUEUE=y
CONFIG_RT_USING_SIGNALS=y
CONFIG_RT_USING_MEMPOOL=y
CONFIG_RT_USING_MEMHEAP=y
CONFIG_RT_USING_MEMHEAP_AS_HEAP=y
CONFIG_RT_USING_HEAP=y
CONFIG_RT_USING_DEVICE=y
CONFIG_RT_USING_DEVICE_OPS=y
CONFIG_RT_USING_CONSOLE=y
CONFIG_RT_CONSOLEBUF_SIZE=256
CONFIG_RT_CONSOLE_DEVICE_NAME="uart"
CONFIG_RT_VER_NUM=0x50000
CONFIG_ARCH_CPU_64BIT=y
CONFIG_RT_USING_CACHE=y
CONFIG_ARCH_MM_MMU=y
CONFIG_RT_USING_USERSPACE=y
CONFIG_KERNEL_VADDR_START=0x150000000
CONFIG_PV_OFFSET=0
CONFIG_ARCH_RISCV=y
CONFIG_ARCH_RISCV64=y
CONFIG_RT_USING_COMPONENTS_INIT=y
CONFIG_RT_USING_USER_MAIN=y
CONFIG_RT_MAIN_THREAD_STACK_SIZE=16384
CONFIG_RT_MAIN_THREAD_PRIORITY=10
CONFIG_RT_USING_MSH=y
CONFIG_RT_USING_FINSH=y
CONFIG_FINSH_USING_MSH=y
CONFIG_FINSH_THREAD_NAME="tshell"
CONFIG_FINSH_THREAD_PRIORITY=20
CONFIG_FINSH_THREAD_STACK_SIZE=81920
CONFIG_FINSH_USING_HISTORY=y
CONFIG_FINSH_HISTORY_LINES=5
CONFIG_FINSH_USING_SYMTAB=y
CONFIG_FINSH_CMD_SIZE=1024
CONFIG_MSH_USING_BUILT_IN_COMMANDS=y
CONFIG_FINSH_USING_DESCRIPTION=y
CONFIG_FINSH_ARG_MAX=100
CONFIG_MSH_WAIT_LWP_FINISH=y
CONFIG_RT_USING_DFS=y
CONFIG_DFS_USING_WORKDIR=y
CONFIG_DFS_FILESYSTEMS_MAX=8
CONFIG_DFS_FILESYSTEM_TYPES_MAX=6
CONFIG_DFS_FD_MAX=64
CONFIG_RT_USING_DFS_ELMFAT=y
CONFIG_RT_DFS_ELM_CODE_PAGE=437
CONFIG_RT_DFS_ELM_WORD_ACCESS=y
CONFIG_RT_DFS_ELM_USE_LFN_3=y
CONFIG_RT_DFS_ELM_USE_LFN=3
CONFIG_RT_DFS_ELM_MAX_LFN=255
CONFIG_RT_DFS_ELM_DRIVES=3
CONFIG_RT_DFS_ELM_MAX_SECTOR_SIZE=512
CONFIG_RT_DFS_ELM_REENTRANT=y
CONFIG_RT_USING_DFS_DEVFS=y
CONFIG_RT_USING_DFS_ROMFS=y
CONFIG_RT_USING_DFS_TMPFS=y
CONFIG_RT_USING_PROC=y
CONFIG_RT_USING_DFS_PROCFS=y
CONFIG_RT_USING_DEVICE_IPC=y
CONFIG_RT_UNAMED_PIPE_NUMBER=64
CONFIG_RT_PIPE_BUFSZ=512
CONFIG_RT_USING_SYSTEM_WORKQUEUE=y
CONFIG_RT_SYSTEM_WORKQUEUE_STACKSIZE=20480
CONFIG_RT_SYSTEM_WORKQUEUE_PRIORITY=23
CONFIG_RT_USING_SERIAL=y
CONFIG_RT_USING_SERIAL_V1=y
CONFIG_RT_SERIAL_USING_DMA=y
CONFIG_RT_SERIAL_RB_BUFSZ=64
CONFIG_RT_USING_TTY=y
CONFIG_RT_USING_HWTIMER=y
CONFIG_RT_USING_CPUTIME=y
CONFIG_RT_USING_CPUTIME_RISCV=y
CONFIG_RT_USING_I2C=y
CONFIG_RT_USING_I2C_BITOPS=y
CONFIG_RT_USING_PIN=y
CONFIG_RT_USING_ADC=y
CONFIG_RT_USING_NULL=y
CONFIG_RT_USING_ZERO=y
CONFIG_RT_USING_RANDOM=y
CONFIG_RT_USING_DEVMEM=y
CONFIG_RT_USING_PWM=y
CONFIG_RT_USING_PM=y
CONFIG_RT_USING_RTC=y
CONFIG_RT_USING_HARDLOCK=y
CONFIG_RT_USING_SDIO=y
CONFIG_RT_SDIO_STACK_SIZE=10240
CONFIG_RT_SDIO_THREAD_PRIORITY=4
CONFIG_RT_MMCSD_STACK_SIZE=32768
CONFIG_RT_MMCSD_THREAD_PRIORITY=22
CONFIG_RT_MMCSD_MAX_PARTITION=16
CONFIG_RT_USING_SPI=y
CONFIG_RT_USING_WDT=y
CONFIG_RT_USING_TOUCH=y
CONFIG_RT_USING_DEV_BUS=y
CONFIG_RT_USING_LIBC=y
CONFIG_RT_USING_MUSL=y
CONFIG_RT_USING_POSIX=y
CONFIG_RT_USING_POSIX_CLOCKTIME=y
CONFIG_RT_USING_LWP=y
CONFIG_RT_LWP_MAX_NR=30
CONFIG_LWP_TASK_STACK_SIZE=16384
CONFIG_RT_CH_MSG_MAX_NR=1024
CONFIG_LWP_CONSOLE_INPUT_BUFFER_SIZE=1024
CONFIG_LWP_TID_MAX_NR=64
CONFIG_RT_LWP_SHM_MAX_NR=64
CONFIG_RT_USING_MPP=y
CONFIG_RT_FASTBOOT=y
CONFIG_RT_USING_GNNE=y
CONFIG_RT_USING_GPIO=y
CONFIG_RT_USING_I2C0=y
CONFIG_RT_USING_I2C1=y
CONFIG_RT_USING_I2C2=y
CONFIG_RT_USING_I2C3=y
CONFIG_RT_USING_I2C4=y
CONFIG_RT_USING_SPI0=y
CONFIG_RT_USING_SPI1=y
CONFIG_RT_USING_SPI2=y
CONFIG_RT_USING_SDIO0=y
CONFIG_RT_USING_SDIO1=y
CONFIG_SDCARD_ON_SDIO_DEV0=y
CONFIG_SDCARD_ON_SDIO_DEV=0
CONFIG_RT_USING_CANAAN_UART=y
CONFIG_RT_USING_UART_CANAAN_1=y
CONFIG_RT_USING_UART_CANAAN_2=y
CONFIG_RT_USING_UART_CANAAN_3=y
CONFIG_RT_USING_UART_CANAAN_4=y
CONFIG_CANAAN_UART_BUFFER_SIZE=131072
CONFIG_POLLIN_SIZE=CANAAN_UART_BUFFER_SIZE/2
CONFIG_UART_TIMEOUT=1000
CONFIG_RT_USING_REGULATOR=y
CONFIG_ENABLE_CHERRY_USB=y
CONFIG_CHERRYUSB_DEVICE_DWC2_K230=y
CONFIG_CHERRYUSB_HOST_DWC2_K230=y
CONFIG_CHERRY_USB_OSAL_RTTHREAD=y
CONFIG_ENABLE_CHERRY_USB_DEVICE=y
CONFIG_CHERRY_USB_DEVICE_USING_DEV0=y
CONFIG_CHERRY_USB_DEVICE_USING_DEV=0
CONFIG_CHERRY_USB_DEVICE_SPEED_HS=y
CONFIG_CHERRY_USB_DEVICE_ENABLE_CLASS_CDC_ACM=y
CONFIG_CHERRY_USB_DEVICE_ENABLE_CLASS_MSC=y
CONFIG_CHERRY_USB_DEVICE_ENABLE_CLASS_MTP=y
CONFIG_ENABLE_CANMV_USB_DEV=y
CONFIG_CANMV_USB_HOST_NET_RTL8152_DEV_NAME="u0"
CONFIG_RT_USING_DEVMEM2=y
CONFIG_RT_USING_USAGE=y
CONFIG_ENABLE_CANMV_MISC_DEV=y
CONFIG_CHIP_K230=y
CONFIG_ENABLE_FPU=y
CONFIG_ENABLE_VECTOR=y
CONFIG___STACKSIZE__=65536
CONFIG_RT_OPTIMIZE_LWP_LOAD=y
CONFIG_RT_VERSION_MAJOR=5
CONFIG_RT_VERSION_MINOR=9
CONFIG_RT_VERSION_PATCH=9
```

## kernel/bsp/maix3/drivers/Kconfig
```kconfig
menu "Drivers Configuration"

    config RT_USING_GPIO
        bool "Enable GPIO Driver"
        default n

    config RT_USING_SPI
        bool "Enable SPI Driver"
        default n

    config RT_USING_REGULATOR
        bool "Enable regulator Driver"
        default n

    menuconfig RT_USING_SDIO
        bool "Enable SDIO Driver"

        if RT_USING_SDIO
            config RT_USING_SDIO0
                bool "Enable SDIO0"
                default n

            if RT_USING_SDIO0
                config RT_SDIO0_EMMC
                    bool "SDIO0 device is eMMC"
                    default n
                config RT_SDIO0_1V8
                    bool "SDIO0 device is 1.8V"
                    default n
            endif

            config RT_USING_SDIO1
                bool "Enable SDIO1"
                default n

            choice SDCARD_ON_SDIO_DEV
                bool "SdCard is on SDIOx"

                config SDCARD_ON_SDIO_DEV0
                    bool "SdCard is on SDIO0"

                config SDCARD_ON_SDIO_DEV1
                    bool "SdCard is on SDIO1"
            endchoice

            config SDCARD_ON_SDIO_DEV
                int 
                default 0 if SDCARD_ON_SDIO_DEV0
                default 1 if SDCARD_ON_SDIO_DEV1
        endif

    menuconfig RT_USING_REALTEK
        bool "Enable Realtek WiFi Driver"

        if RT_USING_REALTEK
            choice REALTEK_SDIO_DEV
                bool "Realtek Wifi Use SDIO Device"

                config REALTEK_SDIO_DEV0
                    bool "Using SDIO0"
                config REALTEK_SDIO_DEV1
                    bool "Using SDIO1"
            endchoice

            config REALTEK_SDIO_DEV
                int
                default 0 if REALTEK_SDIO_DEV0
                default 1 if REALTEK_SDIO_DEV1

        endif

    menuconfig RT_USING_CYW43XX
        bool "Enable CYW43XX WiFi Driver"

        if RT_USING_CYW43XX
            choice CYW43XX_SDIO_DEV
                bool "CYW43XX Wifi Use SDIO Device"

                config CYW43XX_SDIO_DEV0
                    bool "Using SDIO0"
                config CYW43XX_SDIO_DEV1
                    bool "Using SDIO1"
            endchoice

            config CYW43XX_SDIO_DEV
                int
                default 0 if CYW43XX_SDIO_DEV0
                default 1 if CYW43XX_SDIO_DEV1

            config CYW43XX_THREAD_PRIORITY
                int
                default 10
            config CYW43XX_THREAD_STACK_SIZE
                int
                default 4096
        endif

    menuconfig RT_USING_I2C
        bool "Enable I2C"

        if RT_USING_I2C
            config RT_USING_I2C0
                bool "Enable I2C0"
                default y
            config RT_USING_I2C1
                bool "Enable I2C1"
                default y
            config RT_USING_I2C2
                bool "Enable I2C2"
                default y
            config RT_USING_I2C3
                bool "Enable I2C3"
                default y
            config RT_USING_I2C4
                bool "Enable I2C4"
                default y
        endif

endmenu
```
